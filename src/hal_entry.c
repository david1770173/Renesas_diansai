#include "app.h"
#include "hal_data.h"
#include "drv_adc.h"
#include "drv_uart.h"
#include "hal_systick.h"
#include <stdio.h>
#include "bsp_dht11.h"

FSP_CPP_HEADER
void R_BSP_WarmStart(bsp_warm_start_event_t event);
FSP_CPP_FOOTER

static volatile bool gI2CTxCplt = false;
static volatile bool gI2CRxCplt = false;
uint8_t humdity_integer;//????
uint8_t humdity_decimal;//????
uint8_t temp_integer ;//????
uint8_t temp_decimal ;//????
uint8_t dht11_check ;//???

void sci_i2c2_master_callback(i2c_master_callback_args_t *p_args)
{
    if (I2C_MASTER_EVENT_RX_COMPLETE == p_args->event)
    {
        gI2CRxCplt = true;
    }
    else if (I2C_MASTER_EVENT_TX_COMPLETE == p_args->event)
    {
        gI2CTxCplt = true;
    }
}
void drive(int v1,int v2){
	if(v1){
		g_ioport.p_api->pinWrite(g_ioport.p_ctrl, BSP_IO_PORT_09_PIN_07, BSP_IO_LEVEL_HIGH);
		g_ioport.p_api->pinWrite(g_ioport.p_ctrl, BSP_IO_PORT_09_PIN_00, BSP_IO_LEVEL_LOW);
	}
	else{
		g_ioport.p_api->pinWrite(g_ioport.p_ctrl, BSP_IO_PORT_09_PIN_07, BSP_IO_LEVEL_LOW);
		g_ioport.p_api->pinWrite(g_ioport.p_ctrl, BSP_IO_PORT_09_PIN_00, BSP_IO_LEVEL_LOW);
	}
	if(v2){
		g_ioport.p_api->pinWrite(g_ioport.p_ctrl, BSP_IO_PORT_02_PIN_09, BSP_IO_LEVEL_HIGH);
		g_ioport.p_api->pinWrite(g_ioport.p_ctrl, BSP_IO_PORT_02_PIN_11, BSP_IO_LEVEL_LOW);
	}
	else{
		g_ioport.p_api->pinWrite(g_ioport.p_ctrl, BSP_IO_PORT_02_PIN_09, BSP_IO_LEVEL_LOW);
		g_ioport.p_api->pinWrite(g_ioport.p_ctrl, BSP_IO_PORT_02_PIN_11, BSP_IO_LEVEL_LOW);
	}
}
/*******************************************************************************************************************//**
 * main() is generated by the RA Configuration editor and is used to generate threads if an RTOS is used.  This function
 * is called by main() when no RTOS is used.
 **********************************************************************************************************************/
void hal_entry(void)
{
    /* TODO: add your own code here */
    SystickInit();
    UARTDrvInit();
		DHT11_Init();
    ADCDevTypeDef *ptAdcDev = ADCGetDevice();
		R_BSP_PinWrite(BSP_IO_PORT_00_PIN_10, BSP_IO_LEVEL_HIGH); 
    if(NULL == ptAdcDev)
    {
        printf("Error. Not found ADC device!\r\n");
        return;
    }
    printf("Success to find ADC device: %s-%d\r\n", ptAdcDev->name, ptAdcDev->channel);
    ptAdcDev->Init(ptAdcDev);
		 /* TODO: add your own code here */
    fsp_err_t err;
    uint16_t lux_data=0;
		uint8_t powerCommand = 0x01;
		uint8_t measureCommand = 0x10;
    fsp_err_t i2c_err;
		uint8_t cnt=0;
    /* ???? */
    err = g_uart7.p_api->open(g_uart7.p_ctrl, g_uart7.p_cfg);
    i2c_err = g_i2c2.p_api->open(g_i2c2.p_ctrl, g_i2c2.p_cfg);
    if (FSP_SUCCESS == i2c_err)
    {
        printf("Success to open device: i2c4!\r\n");
    }
    else
        printf("Failed to open device: i2c4!\r\n");
    while(1)
    {
				DHT11_Read();
				float ph_value=0;
				
				printf("humdity:%d temperature:%d",humdity_integer,temp_integer);
        R_BSP_SoftwareDelay(500,BSP_DELAY_UNITS_MILLISECONDS);
				uint16_t buf[10] = {0};
				for(uint16_t i=0; i<10; i++){
					ptAdcDev->Read(ptAdcDev, &buf[i], 1);
				}
				printf("\r\nSample Result:\r\n\t");
        for(uint16_t i=0; i<10; i++)
        {
            ph_value += (float)(buf[i]*3.3/4096);
						
            
        }
				printf("ph:%f",ph_value/10*3.5*-4.0+33.6);
				g_i2c2.p_api->write(g_i2c2.p_ctrl, (unsigned char*)&powerCommand, (unsigned int)1, false);
				g_i2c2.p_api->write(g_i2c2.p_ctrl, (unsigned char*)&measureCommand, (unsigned int)1, false);
				R_BSP_SoftwareDelay(300,BSP_DELAY_UNITS_MILLISECONDS);
				g_i2c2.p_api->read(g_i2c2.p_ctrl,(unsigned char*)&lux_data,2,false);
				printf("lux:%f",lux_data/1.2);
        R_BSP_SoftwareDelay(500,BSP_DELAY_UNITS_MILLISECONDS);
				cnt++;
				if(cnt%20==0){
					drive(1,1);
				}
				else if(cnt%10==0){
				drive(0,1);
				}
    }

#if BSP_TZ_SECURE_BUILD
    /* Enter non-secure code */
    R_BSP_NonSecureEnter();
#endif
}

/*******************************************************************************************************************//**
 * This function is called at various points during the startup process.  This implementation uses the event that is
 * called right before main() to set up the pins.
 *
 * @param[in]  event    Where at in the start up process the code is currently at
 **********************************************************************************************************************/
void R_BSP_WarmStart (bsp_warm_start_event_t event)
{
    if (BSP_WARM_START_RESET == event)
    {
#if BSP_FEATURE_FLASH_LP_VERSION != 0

        /* Enable reading from data flash. */
        R_FACI_LP->DFLCTL = 1U;

        /* Would normally have to wait tDSTOP(6us) for data flash recovery. Placing the enable here, before clock and
         * C runtime initialization, should negate the need for a delay since the initialization will typically take more than 6us. */
#endif
    }

    if (BSP_WARM_START_POST_C == event)
    {
        /* C runtime environment and system clocks are setup. */

        /* Configure pins. */
        R_IOPORT_Open(&g_ioport_ctrl, g_ioport.p_cfg);
    }
}

#if BSP_TZ_SECURE_BUILD

BSP_CMSE_NONSECURE_ENTRY void template_nonsecure_callable ();

/* Trustzone Secure Projects require at least one nonsecure callable function in order to build (Remove this if it is not required to build). */
BSP_CMSE_NONSECURE_ENTRY void template_nonsecure_callable ()
{

}
#endif
